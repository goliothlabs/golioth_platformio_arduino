## sdkconfig.defaults
```kconfig
CONFIG_MBEDTLS_SSL_PROTO_DTLS=y
CONFIG_MBEDTLS_PSK_MODES=y
CONFIG_MBEDTLS_KEY_EXCHANGE_PSK=y
CONFIG_GOLIOTH_AUTO_LOG_TO_CLOUD=1
CONFIG_GOLIOTH_COAP_REQUEST_QUEUE_MAX_ITEMS=20
CONFIG_FREERTOS_HZ=1000

# Use setup() and loop() for Arduino
CONFIG_AUTOSTART_ARDUINO=y

# GLTH_LOGX statements will automatically upload to Golioth Logs service
CONFIG_GOLIOTH_AUTO_LOG_TO_CLOUD=1
```
